## meta-my-layerV2/meta-my-layer/conf/layer.conf
```bitbake
# We have a conf and classes directory, add to BBPATH
BBPATH .= ":${LAYERDIR}"

# We have recipes-* directories, add to BBFILES
BBFILES += "${LAYERDIR}/recipes-*/*/*.bb \
            ${LAYERDIR}/recipes-*/*/*.bbappend"

BBFILE_COLLECTIONS += "meta-my-layer"
BBFILE_PATTERN_meta-my-layer = "^${LAYERDIR}/"
BBFILE_PRIORITY_meta-my-layer = "6"

LAYERDEPENDS_meta-my-layer = "core"
LAYERSERIES_COMPAT_meta-my-layer = "scarthgap"

# Fabien
hostname:pn-base-files = "FabienViolier-SDV"

INHERIT += "extrausers"
EXTRA_USERS_PARAMS += "useradd  -p '\$5\$llkBJcniULqiAD1I\$dRNhR2A2gtxZLW3pJhncOqjkS4mQQ7zhu4bwFGCgzZ1' fab;"
EXTRA_USERS_PARAMS += "usermod  -p '\$5\$5AbE8le4VEXVnIJ9\$4eJ.RHvoyRhPK8aPwp6aoKCx2YzXzID2CbkxLs1EqTC'  root;"

IMAGE_INSTALL:append = " mc"
IMAGE_INSTALL:append = " dtc valgrind"
IMAGE_INSTALL:append = " gdbserver powertop"
IMAGE_INSTALL:append = " nano"
IMAGE_INSTALL:append = " resolvconf"
IMAGE_INSTALL:append = " vsomeip boost"
IMAGE_INSTALL:append = " wpa-supplicant  linux-firmware"

DISTRO_FEATURES += "bluetooth wifi ipv4 ipv6"

IMAGE_FEATURES += "tools-sdk"


# END Fabien
```
